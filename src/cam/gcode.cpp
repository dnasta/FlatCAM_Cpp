/**
 * @file gcode.cpp
 * @brief Generación de G-code, preprocesadores y optimización de recorridos.
 *
 * Convierte taladros (`DrillJob`) y recorridos (`PathJob`, `PathToolJob`) en
 * programas para MACH3, GRBL, Marlin, Repetier, ISEL, Roland, HPGL y láser.
 * Incluye helpers de cabecera y cambio de herramienta, dosificación de pasta,
 * optimización de orden (TSP exacto, vecino más cercano, 2-opt y Or-opt) y la
 * construcción de trabajos desde un Excellon parseado.
 */

#include "flatcam/gcode.hpp"

#include <algorithm>
#include <limits>
#include <cmath>
#include <cstdio>
#include <sstream>

#include "flatcam/excellon.hpp"

namespace fc {
namespace {

// Declaración adelantada: `number` se define al final de los helpers y la usan
// las cabeceras y los comandos de cambio de herramienta.
std::string number(double value, int decimals);

/**
 * @brief Indica si el postprocesador corresponde a un modo láser.
 *
 * En modo láser no se emiten bajadas de Z: la potencia se controla con comandos
 * del tipo `M03`/`M106` según el firmware.
 *
 * @param flavor Perfil de postprocesador.
 * @return `true` para `GrblLaser`, `MarlinLaserFan`, `MarlinLaserSpindle` y
 *         `ZLaser`.
 */
bool isLaserFlavor(GCodeFlavor flavor) {
    return flavor == GCodeFlavor::GrblLaser || flavor == GCodeFlavor::MarlinLaserFan ||
           flavor == GCodeFlavor::MarlinLaserSpindle || flavor == GCodeFlavor::ZLaser;
}

/**
 * @brief Indica si el perfil emite `M6` (cambio de herramienta real).
 *
 * Los perfiles "sin M6" (`Grbl`, `GrblNoM6`, `DefaultNoM6`, etc.) dejan el
 * cambio de herramienta como un comentario `MSG`, pensado para routers con
 * cambio manual asistido.
 *
 * @param flavor Perfil de postprocesador.
 * @return `true` para MACH3, Marlin, Repetier, Berta, ISEL, Roland, cambio
 *         manual y sonda; `false` para GRBL, láser, HPGL y línea XYZ.
 */
bool usesM6(GCodeFlavor flavor) {
    switch (flavor) {
        case GCodeFlavor::Default:
        case GCodeFlavor::Marlin:
        case GCodeFlavor::Repetier:
        case GCodeFlavor::Berta:
        case GCodeFlavor::Isel:
        case GCodeFlavor::IselIcp:
        case GCodeFlavor::Roland:
        case GCodeFlavor::ToolchangeManual:
        case GCodeFlavor::ToolchangeProbe:
            return true;
        default:
            return false;
    }
}

/**
 * @brief Devuelve el comentario de identificación del preprocesador.
 *
 * Reproduce los textos de FlatCAM (incluido el `IMF_PBL flatcam` de ISEL ICP y
 * el uso de `;` en Repetier/ISEL ICP en lugar de paréntesis). El texto se
 * escribe al inicio del programa para que el operador identifique el firmware.
 *
 * @param flavor Perfil de postprocesador.
 * @return Línea(s) de comentario terminadas en `\n`.
 */
std::string flavorHeader(GCodeFlavor flavor) {
    switch (flavor) {
        case GCodeFlavor::Marlin:
        case GCodeFlavor::MarlinLaserFan:
        case GCodeFlavor::MarlinLaserSpindle:
            return "(This preprocessor is used with Marlin firmware.)\n";
        case GCodeFlavor::Grbl:
        case GCodeFlavor::GrblNoM6:
        case GCodeFlavor::GrblLaser:
            return "(This preprocessor is used with a motion controller loaded with GRBL firmware.)\n";
        case GCodeFlavor::Repetier:
            return "; This preprocessor is used with a motion controller loaded with REPETIER firmware.\n";
        case GCodeFlavor::Berta:
            return "(This preprocessor is used with a BERTA CNC router.)\n";
        case GCodeFlavor::Isel:
            return "(This preprocessor is used with a ISEL CNC router.)\n";
        case GCodeFlavor::IselIcp:
            return "; This preprocessor is used with a ISEL ICP CNC router.\nIMF_PBL flatcam\n";
        case GCodeFlavor::Roland:
            return "(This preprocessor is used with a Roland MDX-20.)\n";
        case GCodeFlavor::ToolchangeManual:
            return "(This preprocessor is used with MACH3 and manual tool change.)\n";
        case GCodeFlavor::ToolchangeProbe:
            return "(This preprocessor is used with MACH3 with probing height.)\n";
        case GCodeFlavor::ZLaser:
            return "(This preprocessor controls a laser through the Z axis.)\n";
        case GCodeFlavor::Hpgl:
            return "(HPGL plotter output generated by FlatCAM C++.)\n";
        case GCodeFlavor::LineXyz:
            return "(This preprocessor writes XYZ on every linear move.)\n";
        case GCodeFlavor::ToolchangeCustom:
            return "(Custom tool change preprocessor.)\n";
        default:
            return "(This preprocessor is the default preprocessor used by FlatCAM.)\n"
                   "(It is made to work with MACH3 compatible motion controllers.)\n";
    }
}

/**
 * @brief Construye el comando de encendido del láser con la potencia dada.
 *
 * @param flavor Perfil del postprocesador (decide el comando).
 * @param power Potencia en unidades del firmware (se formatea con 1 decimal).
 * @return `M106 S<power>` para Marlin con ventilador, `M3 S<power>` para Marlin
 *         con spindle y `M03 S<power>` en el resto (incluido GRBL láser).
 */
std::string laserOnCommand(GCodeFlavor flavor, double power) {
    std::string value = number(power, 1);
    switch (flavor) {
        case GCodeFlavor::MarlinLaserFan: return "M106 S" + value;
        case GCodeFlavor::MarlinLaserSpindle: return "M3 S" + value;
        default: return "M03 S" + value;
    }
}

/**
 * @brief Devuelve el comando de apagado del láser.
 * @param flavor Perfil del postprocesador.
 * @return `M107` para Marlin con ventilador; `M5` en el resto.
 */
std::string laserOffCommand(GCodeFlavor flavor) {
    return flavor == GCodeFlavor::MarlinLaserFan ? "M107" : "M5";
}

/**
 * @brief Reemplaza todas las apariciones de `from` por `to` en `text`.
 *
 * Sustitución literal (sin expresiones regulares) que avanza `pos` después del
 * texto insertado, de modo que no se re-procesa lo reemplazado.
 *
 * @param text Cadena a modificar in situ.
 * @param from Texto buscado; si está vacío la función no hace nada.
 * @param to Texto de reemplazo.
 */
void replaceAll(std::string& text, const std::string& from, const std::string& to) {
    if (from.empty()) return;
    std::size_t pos = 0;
    while ((pos = text.find(from, pos)) != std::string::npos) {
        text.replace(pos, from.size(), to);
        pos += to.size();
    }
}

/**
 * @brief Expande la plantilla de cambio de herramienta personalizada.
 *
 * Reemplaza los marcadores `{tool}`, `{diameter}`, `{z}`, `{x}` e `{y}` con los
 * valores de la herramienta y de las opciones de máquina. Si no hay posición de
 * cambio definida (`toolchangeXY`), `{x}` e `{y}` se sustituyen por `0`.
 *
 * @param opt Opciones que contienen la plantilla y los decimales de formato.
 * @param tool Número de herramienta.
 * @param diameter Diámetro de la herramienta.
 * @return Código resultante, sin salto de línea final.
 *
 * @note No valida la plantilla: un marcador mal escrito queda tal cual en el
 *       G-code y puede provocar un error de sintaxis en el controlador.
 */
std::string customToolchangeCode(const GCodeOptions& opt, int tool, double diameter) {
    std::string code = opt.customToolchange;
    replaceAll(code, "{tool}", std::to_string(tool));
    replaceAll(code, "{diameter}", number(diameter, opt.decimals));
    replaceAll(code, "{z}", number(opt.zToolchange, opt.decimals));
    replaceAll(code, "{x}", number(opt.toolchangeXY ? opt.toolchangeXY->x : 0.0, opt.decimals));
    replaceAll(code, "{y}", number(opt.toolchangeXY ? opt.toolchangeXY->y : 0.0, opt.decimals));
    return code;
}

/// @brief Formatea `value` con `decimals` decimales usando `snprintf`.
std::string number(double value, int decimals) {
    char buffer[64];
    std::snprintf(buffer, sizeof(buffer), "%.*f", decimals, value);
    return std::string(buffer);
}

/// @brief Devuelve `X<x> Y<y>` con los decimales configurados.
std::string xy(const Pt& p, const GCodeOptions& opt) {
    return "X" + number(p.x, opt.decimals) + " Y" + number(p.y, opt.decimals);
}

/// @brief Z de corte efectiva: override de la herramienta o valor global.
double toolZCut(const DrillTool& tool, const GCodeOptions& opt) {
    return tool.zCut.value_or(opt.zCut);
}

/// @brief Avance de penetración efectivo: override de la herramienta o global.
double toolFeedZ(const DrillTool& tool, const GCodeOptions& opt) {
    return tool.feedZ.value_or(opt.feedZ);
}

/**
 * @brief Escribe la cabecera de un programa de taladrado.
 *
 * La cabecera documenta el preprocesador, la tabla de herramientas (diámetro,
 * Z de corte y Z de viaje), los rangos X/Y, las RPM, las unidades (`G20`/`G21`),
 * el modo absoluto (`G90`) y el avance por minuto (`G94`). Después enciende el
 * husillo si `spindleSpeed > 0` y eleva a `zStart`.
 *
 * @param out Flujo de salida del programa.
 * @param job Trabajo de taladrado (herramientas y límites).
 * @param opt Parámetros de máquina y formato.
 *
 * @note El `M03`/`M04` inicial respeta `opt.spindleCw`; las herramientas con
 *       override de RPM vuelven a emitir su propio `M03` en `drillingGCode`.
 * @note Los comentarios usan paréntesis, válidos tanto en MACH3 como en GRBL.
 */
void writeHeader(std::ostringstream& out, const DrillJob& job, const GCodeOptions& opt) {
    out << flavorHeader(opt.flavor);
    out << "(Generated by FlatCAM C++.)\n\n";

    out << "(TOOLS DIAMETER: )\n";
    for (const DrillTool& tool : job.tools) {
        out << "(Tool: " << tool.number << " -> Dia: " << number(tool.diameter, opt.decimals) << ")\n";
    }
    out << "\n(Z_CUT: )\n";
    for (const DrillTool& tool : job.tools) {
        out << "(Tool: " << tool.number << " -> Z_Cut: " << number(toolZCut(tool, opt), opt.decimals) << ")\n";
    }
    out << "\n(Z_MOVE: )\n";
    for (const DrillTool& tool : job.tools) {
        out << "(Tool: " << tool.number << " -> Z_Move: " << number(opt.zMove, opt.decimals) << ")\n";
    }
    if (job.bounds.valid) {
        out << "\n(X range: " << number(job.bounds.xmin, opt.decimals) << " ... "
            << number(job.bounds.xmax, opt.decimals) << ")\n";
        out << "(Y range: " << number(job.bounds.ymin, opt.decimals) << " ... "
            << number(job.bounds.ymax, opt.decimals) << ")\n";
    }
    out << "\n(Spindle Speed: " << number(opt.spindleSpeed, 0) << " RPM)\n";
    out << (opt.units == Units::Inch ? "G20\n" : "G21\n");
    out << "G90\n";
    out << "G94\n";
    if (opt.spindleSpeed > 0.0) {
        out << (opt.spindleCw ? "M03" : "M04");
        out << " S" << number(opt.spindleSpeed, 0) << "\n";
    }
    out << "G00 Z" << number(opt.zStart, opt.decimals) << "\n";
}

/**
 * @brief Emite el cambio de herramienta para una herramienta de taladrado.
 *
 * Tres caminos posibles:
 * - `ToolchangeCustom` con plantilla no vacía: expande la plantilla y baja a
 *   `zMove`, sin `M6`.
 * - `includeToolChange` activo: apaga el husillo (`M5`), sube a `zToolchange`,
 *   viaja a la posición de cambio si está definida, selecciona con `Tn` y, si
 *   el perfil usa `M6`, emite `M6` + comentario con diámetro y cantidad de
 *   taladros + `M0` (pausa). Sin `M6` deja sólo el comentario `MSG`.
 * - En cualquier otro caso no escribe nada (el programa sigue con la
 *   herramienta anterior).
 *
 * @param out Flujo de salida del programa.
 * @param tool Herramienta que se va a montar.
 * @param opt Parámetros de máquina y postprocesador.
 *
 * @note La cantidad informada en el mensaje suma taladros y ranuras, útil para
 *       que el operador verifique la herramienta antes de continuar.
 * @note Termina siempre en `zMove` para que el primer rápido se haga en altura
 *       segura.
 */
void writeToolChange(std::ostringstream& out, const DrillTool& tool, const GCodeOptions& opt) {
    if (opt.flavor == GCodeFlavor::ToolchangeCustom && !opt.customToolchange.empty()) {
        out << customToolchangeCode(opt, tool.number, tool.diameter) << "\n";
        out << "G00 Z" << number(opt.zMove, opt.decimals) << "\n";
        return;
    }
    if (opt.includeToolChange) {
        out << "M5\n";
        out << "G00 Z" << number(opt.zToolchange, opt.decimals) << "\n";
        if (opt.toolchangeXY) {
            out << "G00 " << xy(*opt.toolchangeXY, opt) << "\n";
        }
        out << "T" << tool.number << "\n";
        if (usesM6(opt.flavor)) {
            out << "M6\n";
            out << "(MSG, Change to Tool Dia = " << number(tool.diameter, opt.decimals)
                << " ||| Total drills for tool T" << tool.number << " = "
                << (tool.holes.size() + tool.slotSegments.size()) << ")\n";
            out << "M0\n";
        } else {
            out << "(MSG, Change to Tool Dia = " << number(tool.diameter, opt.decimals) << ")\n";
        }
        out << "G00 Z" << number(opt.zToolchange, opt.decimals) << "\n";
        out << "G00 Z" << number(opt.zMove, opt.decimals) << "\n";
    }
}

/// @brief Z de viaje efectiva: override de la herramienta o valor global.
double toolZMove(const DrillTool& tool, const GCodeOptions& opt) {
    return tool.zMove.value_or(opt.zMove);
}

/**
 * @brief Escribe el ciclo de un taladro simple (centro + penetración).
 *
 * Secuencia: rápido al centro (aplicando `offsetX/offsetY` de la herramienta),
 * penetración a `zCut` con avance `feedZ` —o varias penetraciones parciales de
 * `depthPerPass` con retracción a `zMove` entre cada una (peck drilling)—,
 * pausa `G04` si corresponde y retracción final a `zMove`.
 *
 * @param out Flujo de salida del programa.
 * @param holeIn Centro del taladro en coordenadas originales.
 * @param tool Herramienta (diámetro, overrides y offsets).
 * @param opt Parámetros globales (Z, avances, dwell y profundidad por pasada).
 *
 * @note El peck drilling sólo se activa si `depthPerPass > 0`, la Z de corte es
 *       negativa y su magnitud supera la profundidad por pasada.
 * @note La pausa usa `tool.dwell` si existe; si no, `opt.dwellTime`.
 * @warning No se emite `G98`/`G99`: el retorno siempre es a `zMove`, no a la
 *          altura inicial del ciclo.
 */
void writeHole(std::ostringstream& out, const Pt& holeIn, const DrillTool& tool, const GCodeOptions& opt) {
    const Pt hole{holeIn.x + tool.offsetX, holeIn.y + tool.offsetY};
    const double zCut = toolZCut(tool, opt);
    const double zMove = toolZMove(tool, opt);
    const double feedZ = toolFeedZ(tool, opt);
    const double peck = opt.depthPerPass;
    out << "G00 " << xy(hole, opt) << "\n";
    if (peck > 0.0 && zCut < 0.0 && std::fabs(zCut) > peck + 1e-9) {
        double z = 0.0;
        while (z > zCut + 1e-9) {
            z = std::max(zCut, z - peck);
            out << "G01 Z" << number(z, opt.decimals) << " F"
                << number(feedZ, opt.feedDecimals) << "\n";
            if (z > zCut + 1e-9) {
                out << "G00 Z" << number(zMove, opt.decimals) << "\n";
                out << "G00 " << xy(hole, opt) << "\n";
            }
        }
    } else {
        out << "G01 Z" << number(zCut, opt.decimals) << " F"
            << number(feedZ, opt.feedDecimals) << "\n";
    }
    const double dwell = tool.dwell.value_or(opt.dwellTime);
    if (dwell > 0.0) out << "G04 P" << number(dwell, opt.feedDecimals) << "\n";
    out << "G00 Z" << number(zMove, opt.decimals) << "\n";
}

/**
 * @brief Escribe el fresado de una ranura (de `start` a `stop` en una pasada).
 *
 * Repite el esquema de penetración de `writeHole` (con peck opcional) en el
 * punto inicial y luego avanza en línea recta hasta el extremo con el avance
 * XY de la herramienta o el global, para terminar retrayendo a `zMove`.
 *
 * @param out Flujo de salida del programa.
 * @param startIn Extremo inicial de la ranura.
 * @param stopIn Extremo final de la ranura.
 * @param tool Herramienta (offsets y overrides de avance).
 * @param opt Parámetros globales.
 *
 * @note A diferencia de `writeHole`, no emite `G04`: una pausa en una ranura no
 *       tiene sentido práctico y se omite para no alargar el ciclo.
 * @note El peck drilling se aplica sólo en el extremo inicial; la pasada
 *       lateral se hace a la profundidad final ya alcanzada.
 */
void writeSlot(std::ostringstream& out, const Pt& startIn, const Pt& stopIn, const DrillTool& tool,
               const GCodeOptions& opt) {
    const Pt start{startIn.x + tool.offsetX, startIn.y + tool.offsetY};
    const Pt stop{stopIn.x + tool.offsetX, stopIn.y + tool.offsetY};
    const double zCut = toolZCut(tool, opt);
    const double zMove = toolZMove(tool, opt);
    const double feedZ = toolFeedZ(tool, opt);
    const double peck = opt.depthPerPass;
    out << "G00 " << xy(start, opt) << "\n";
    if (peck > 0.0 && zCut < 0.0 && std::fabs(zCut) > peck + 1e-9) {
        double z = 0.0;
        while (z > zCut + 1e-9) {
            z = std::max(zCut, z - peck);
            out << "G01 Z" << number(z, opt.decimals) << " F"
                << number(feedZ, opt.feedDecimals) << "\n";
            if (z > zCut + 1e-9) {
                out << "G00 Z" << number(zMove, opt.decimals) << "\n";
                out << "G00 " << xy(start, opt) << "\n";
            }
        }
    } else {
        out << "G01 Z" << number(zCut, opt.decimals) << " F"
            << number(feedZ, opt.feedDecimals) << "\n";
    }
    out << "G01 " << xy(stop, opt) << " F"
        << number(tool.feedXY.value_or(opt.feedXY), opt.feedDecimals) << "\n";
    out << "G00 Z" << number(zMove, opt.decimals) << "\n";
}

}  // namespace

/**
 * @brief Genera el programa G-code completo de un trabajo de taladrado.
 *
 * Escribe la cabecera y, por cada herramienta con contenido, el cambio de
 * herramienta, el override de RPM si corresponde y todos sus taladros y
 * ranuras. Las ranuras degeneradas (`start == stop`) se emiten como taladro
 * simple. Al final apaga el husillo, sube a `zEnd` y, si se pidió, se desplaza
 * a `endXY`.
 *
 * @param job Herramientas con taladros y ranuras.
 * @param opt Parámetros de máquina, unidades y postprocesador.
 * @return Programa G-code como cadena.
 *
 * @note Las herramientas sin taladros ni ranuras se omiten por completo, de
 *       modo que no se emite un cambio de herramienta inútil.
 * @note `M05` sólo se emite si la cabecera encendió el husillo
 *       (`spindleSpeed > 0`), evitando comandos huérfanos en programas sin
 *       husillo configurado.
 * @warning Los overrides de RPM por herramienta emiten `M03` sin apagar antes
 *          el husillo (`M05`); en MACH3 puede ser aceptable, pero no todas las
 *          controladoras aceptan un cambio de sentido en caliente.
 */
std::string drillingGCode(const DrillJob& job, const GCodeOptions& opt) {
    std::ostringstream out;
    writeHeader(out, job, opt);

    for (const DrillTool& tool : job.tools) {
        if (tool.holes.empty() && tool.slotSegments.empty()) continue;
        writeToolChange(out, tool, opt);
        if (tool.spindleSpeed && *tool.spindleSpeed > 0.0)
            out << "M03 S" << number(*tool.spindleSpeed, 0) << "\n";
        for (const Pt& hole : tool.holes) {
            writeHole(out, hole, tool, opt);
        }
        for (const auto& [start, stop] : tool.slotSegments) {
            if (start.x == stop.x && start.y == stop.y) {
                writeHole(out, start, tool, opt);
            } else {
                writeSlot(out, start, stop, tool, opt);
            }
        }
    }

    if (opt.spindleSpeed > 0.0) out << "M05\n";
    out << "G00 Z" << number(opt.zEnd, opt.decimals) << "\n";
    if (opt.endXY) out << "G00 " << xy(*opt.endXY, opt) << "\n";
    return out.str();
}

namespace {

/// @brief Distancia euclidiana entre dos puntos.
double dist(const Pt& a, const Pt& b) { return std::hypot(b.x - a.x, b.y - a.y); }

/**
 * @brief Longitud del recorrido que visita `holes` en orden partiendo de `start`.
 * @param holes Taladros en su orden actual.
 * @param start Punto de partida.
 * @return Distancia acumulada en mm.
 */
double holesDistance(const std::vector<Pt>& holes, const Pt& start) {
    double total = 0.0;
    Pt current = start;
    for (const Pt& hole : holes) {
        total += dist(current, hole);
        current = hole;
    }
    return total;
}

/**
 * @brief Ordena `points` por vecino más cercano partiendo de `start`.
 *
 * En cada iteración busca el punto no visitado de menor distancia al actual.
 * Es O(n²) y se usa como solución inicial de las heurísticas de mejora
 * (2-opt y Or-opt) cuando hay más taladros que el límite del TSP exacto.
 *
 * @param points Puntos a reordenar (se modifican in situ).
 * @param start Punto de partida.
 */
void sortNearest(std::vector<Pt>& points, const Pt& start) {
    std::vector<Pt> remaining = points;
    std::vector<Pt> ordered;
    ordered.reserve(points.size());
    Pt current = start;
    while (!remaining.empty()) {
        std::size_t best = 0;
        double bestDistance = dist(current, remaining[0]);
        for (std::size_t i = 1; i < remaining.size(); ++i) {
            const double d = dist(current, remaining[i]);
            if (d < bestDistance) {
                bestDistance = d;
                best = i;
            }
        }
        current = remaining[best];
        ordered.push_back(current);
        remaining.erase(remaining.begin() + static_cast<std::ptrdiff_t>(best));
    }
    points = std::move(ordered);
}

/**
 * @brief Mejora el orden con la heurística 2-opt (intercambio de aristas).
 *
 * Para cada par `(i, j)` evalúa el efecto de invertir el subrecorrido
 * `[i, j]`: compara las aristas afectadas antes y después (incluida la arista
 * que llega desde `start` cuando `i == 0`) y acepta el cambio si reduce la
 * longitud en más de 1e-9 mm. Repite hasta que no haya mejoras o hasta 200
 * rondas.
 *
 * @param points Orden de puntos a mejorar (in situ).
 * @param start Punto de partida, tratado como predecesor de `points[0]`.
 *
 * @note El límite de 200 rondas actúa como guarda contra ciclos por errores de
 *       redondeo en conjuntos muy grandes.
 * @note El delta ignora la arista de salida cuando `j` es el último punto, que
 *       es correcto porque no hay arista posterior que invertir.
 */
void twoOpt(std::vector<Pt>& points, const Pt& start) {
    if (points.size() < 3) return;
    bool improved = true;
    int guard = 0;
    while (improved && guard++ < 200) {
        improved = false;
        for (std::size_t i = 0; i + 1 < points.size(); ++i) {
            for (std::size_t j = i + 1; j < points.size(); ++j) {
                const Pt& a = i == 0 ? start : points[i - 1];
                const Pt& b = points[i];
                const Pt& c = points[j];
                const double before = dist(a, b);
                const double after = dist(a, c);
                double delta = after - before;
                if (j + 1 < points.size()) {
                    const Pt& d = points[j + 1];
                    delta += dist(b, d) - dist(c, d);
                }
                if (delta < -1e-9) {
                    std::reverse(points.begin() + static_cast<std::ptrdiff_t>(i),
                                 points.begin() + static_cast<std::ptrdiff_t>(j) + 1);
                    improved = true;
                }
            }
        }
    }
}

/**
 * @brief Longitud total del recorrido `start → points…` (sin retorno).
 * @param points Orden de visita.
 * @param start Punto de partida.
 * @return Distancia acumulada en mm.
 */
double pathLengthWithStart(const std::vector<Pt>& points, const Pt& start) {
    double total = 0.0;
    Pt current = start;
    for (const Pt& p : points) {
        total += dist(current, p);
        current = p;
    }
    return total;
}

/**
 * @brief Resuelve el TSP abierto de forma exacta con programación dinámica.
 *
 * Implementa Held-Karp sobre subconjuntos: `dp[mask][i]` es el costo mínimo de
 * visitar `mask` terminando en `i`, partiendo de `start`. Reconstruye el orden
 * óptimo siguiendo la matriz `parent`.
 *
 * @param points Taladros a ordenar.
 * @param start Punto de partida.
 * @return Orden óptimo, o `points` sin cambios si hay más de 18 elementos.
 *
 * @note El límite de 18 puntos acota la tabla a 2^18 × 18 entradas
 *       (≈ 4,7 M celdas por matriz); con más puntos se usan las heurísticas.
 * @note Para `n == 0` devuelve un vector vacío sin tocar las matrices.
 * @warning Con `n == 18` el consumo de memoria (dos matrices de `double`/`int`)
 *          ronda las decenas de MB; es el motivo del límite.
 */
std::vector<Pt> exactTsp(const std::vector<Pt>& points, const Pt& start) {
    const std::size_t n = points.size();
    if (n > 18) return points;

    const std::size_t states = std::size_t{1} << n;
    const double inf = std::numeric_limits<double>::infinity();
    std::vector<std::vector<double>> dp(states, std::vector<double>(n, inf));
    std::vector<std::vector<int>> parent(states, std::vector<int>(n, -1));

    for (std::size_t i = 0; i < n; ++i) {
        dp[std::size_t{1} << i][i] = dist(start, points[i]);
    }

    for (std::size_t mask = 1; mask < states; ++mask) {
        for (std::size_t i = 0; i < n; ++i) {
            if (!(mask & (std::size_t{1} << i)) || !std::isfinite(dp[mask][i])) continue;
            for (std::size_t j = 0; j < n; ++j) {
                if (mask & (std::size_t{1} << j)) continue;
                const std::size_t next = mask | (std::size_t{1} << j);
                const double cost = dp[mask][i] + dist(points[i], points[j]);
                if (cost < dp[next][j]) {
                    dp[next][j] = cost;
                    parent[next][j] = static_cast<int>(i);
                }
            }
        }
    }

    std::size_t last = 0;
    double best = inf;
    const std::size_t full = states - 1;
    for (std::size_t i = 0; i < n; ++i) {
        if (dp[full][i] < best) {
            best = dp[full][i];
            last = i;
        }
    }

    std::vector<Pt> ordered(n);
    std::size_t mask = full;
    std::size_t current = last;
    for (std::size_t k = n; k > 0; --k) {
        ordered[k - 1] = points[current];
        const int previous = parent[mask][current];
        mask &= ~(std::size_t{1} << current);
        if (previous < 0) break;
        current = static_cast<std::size_t>(previous);
    }
    return ordered;
}

/**
 * @brief Reubica puntos uno a uno con la heurística Or-opt.
 *
 * Para cada punto prueba a extraerlo e insertarlo en todas las posiciones
 * posibles, conservando el cambio cuando la longitud total disminuye. Repite
 * hasta que no haya mejoras o hasta 50 rondas.
 *
 * @param points Orden a mejorar (in situ).
 * @param start Punto de partida para medir la longitud.
 *
 * @note Se usa como refinamiento final tras el 2-opt en conjuntos grandes.
 * @warning La implementación reconstruye el vector completo en cada intento
 *          (O(n³) por ronda); con miles de taladros puede ser costosa.
 */
void orOpt(std::vector<Pt>& points, const Pt& start) {
    if (points.size() < 3) return;
    bool improved = true;
    int guard = 0;
    while (improved && guard++ < 50) {
        improved = false;
        for (std::size_t i = 0; i < points.size(); ++i) {
            std::vector<Pt> candidate = points;
            const Pt point = candidate[i];
            candidate.erase(candidate.begin() + static_cast<std::ptrdiff_t>(i));

            double bestLength = pathLengthWithStart(points, start);
            std::size_t bestPos = i;
            for (std::size_t pos = 0; pos <= candidate.size(); ++pos) {
                std::vector<Pt> trial = candidate;
                trial.insert(trial.begin() + static_cast<std::ptrdiff_t>(pos), point);
                const double length = pathLengthWithStart(trial, start);
                if (length < bestLength - 1e-9) {
                    bestLength = length;
                    bestPos = pos;
                }
            }
            if (bestPos != i) {
                candidate.insert(candidate.begin() + static_cast<std::ptrdiff_t>(bestPos), point);
                points = std::move(candidate);
                improved = true;
            }
        }
    }
}

}  // namespace

/**
 * @brief Calcula el recorrido XY total de un trabajo de taladrado.
 *
 * Suma los viajes entre taladros consecutivos de cada herramienta, el salto
 * entre herramientas y los desplazamientos de las ranuras (inicio y fin). No
 * incluye movimientos en Z ni retracciones.
 *
 * @param job Trabajo a medir.
 * @param start Punto de partida (por defecto el origen de máquina).
 * @return Distancia total en mm.
 *
 * @note Se usa para comparar el efecto de las optimizaciones de orden.
 * @note El punto de continuación tras una herramienta es su último taladro;
 *       si la herramienta no tiene taladros se mantiene el punto anterior.
 */
double drillTravelDistance(const DrillJob& job, const Pt& start) {
    double total = 0.0;
    Pt current = start;
    for (const DrillTool& tool : job.tools) {
        total += holesDistance(tool.holes, current);
        if (!tool.holes.empty()) current = tool.holes.back();
        for (const auto& [slotStart, slotEnd] : tool.slotSegments) {
            total += dist(current, slotStart);
            total += dist(slotStart, slotEnd);
            current = slotEnd;
        }
    }
    return total;
}

/**
 * @brief Reordena taladros y ranuras del trabajo para reducir los rápidos.
 *
 * Con `DrillOrder::AsIs` no hace nada. En otro caso, para cada herramienta:
 * - hasta 18 taladros usa el TSP exacto (Held-Karp);
 * - con más, aplica vecino más cercano + 2-opt + Or-opt.
 *
 * Después ordena las ranuras por cercanía al punto actual y actualiza el punto
 * de partida con el extremo final de cada elemento para que la herramienta
 * siguiente continúe cerca.
 *
 * @param job Trabajo a modificar in situ.
 * @param order Estrategia de orden.
 * @param start Punto de partida (origen o posición real de la máquina).
 *
 * @note El orden se optimiza herramienta por herramienta, no globalmente: el
 *       orden de las herramientas lo define el archivo original.
 * @note Las ranuras se ordenan con comparador que captura `current` por
 *       referencia; el valor no cambia durante el `std::sort`, por lo que el
 *       criterio es estable.
 * @warning El comparador no es un orden débil estricto ante distancias
 *          exactamente iguales, aunque al comparar sólo con `<` no dispara la
 *          mayoría de las aserciones de las bibliotecas estándar.
 */
void optimizeDrillOrder(DrillJob& job, DrillOrder order, const Pt& start) {
    if (order == DrillOrder::AsIs) return;
    Pt current = start;
    for (DrillTool& tool : job.tools) {
        if (tool.holes.size() <= 18) {
            tool.holes = exactTsp(tool.holes, current);
        } else {
            sortNearest(tool.holes, current);
            twoOpt(tool.holes, current);
            orOpt(tool.holes, current);
        }
        if (!tool.holes.empty()) current = tool.holes.back();

        std::sort(tool.slotSegments.begin(), tool.slotSegments.end(),
                  [&current](const auto& a, const auto& b) {
                      return dist(current, a.first) < dist(current, b.first);
                  });
        for (const auto& [slotStart, slotEnd] : tool.slotSegments) {
            (void)slotStart;
            current = slotEnd;
        }
    }
}

/**
 * @brief Reordena los recorridos de geometría eligiendo el extremo más cercano.
 *
 * Greedy por vecino más cercano sobre los extremos: para cada paso compara la
 * distancia al inicio y al final de cada recorrido pendiente, elige el menor e
 * invierte el recorrido si conviene empezar por su extremo final. No aplica
 * 2-opt porque los recorridos no son puntos intercambiables.
 *
 * @param job Trabajo a modificar in situ (recorridos de una herramienta).
 * @param start Punto de partida (normalmente el origen).
 *
 * @note Los recorridos con menos de 2 puntos se descartan del resultado, ya que
 *       no se pueden mecanizar.
 * @note Es una heurística: no garantiza el mínimo global del recorrido en vacío.
 */
void optimizePathOrder(PathJob& job, const Pt& start) {
    if (job.paths.size() < 2) return;

    std::vector<std::vector<Pt>> remaining = job.paths;
    std::vector<std::vector<Pt>> ordered;
    ordered.reserve(job.paths.size());
    Pt current = start;

    while (!remaining.empty()) {
        std::size_t best = 0;
        bool reverse = false;
        double bestDistance = std::numeric_limits<double>::infinity();
        for (std::size_t i = 0; i < remaining.size(); ++i) {
            if (remaining[i].size() < 2) continue;
            const double dStart = dist(current, remaining[i].front());
            const double dEnd = dist(current, remaining[i].back());
            if (dStart < bestDistance) {
                bestDistance = dStart;
                best = i;
                reverse = false;
            }
            if (dEnd < bestDistance) {
                bestDistance = dEnd;
                best = i;
                reverse = true;
            }
        }
        std::vector<Pt> path = remaining[best];
        if (reverse) std::reverse(path.begin(), path.end());
        current = path.back();
        ordered.push_back(std::move(path));
        remaining.erase(remaining.begin() + static_cast<std::ptrdiff_t>(best));
    }
    job.paths = std::move(ordered);
}

namespace {

/**
 * @brief Genera un programa de geometría en modo láser (sin eje Z).
 *
 * Escribe una cabecera específica (foco en Z, potencia, límites), fija
 * `G21/G90/G17/G94`, posiciona en `zFocus` y recorre los caminos encendiendo el
 * láser con el comando del firmware.
 *
 * @param job Recorridos a mecanizar.
 * @param opt Parámetros de máquina y postprocesador.
 * @return Programa G-code en modo láser.
 *
 * @note El avance de los rápidos se documenta como 1500 mm/min, pero no se
 *       emite ningún `G00 F...`: es sólo informativo.
 * @note El haz se apaga antes de cada rápido y se vuelve a encender al llegar
 *       al inicio del recorrido, de modo que los `G00` no marcan el material.
 */
std::string laserPathsGCode(const PathJob& job, const GCodeOptions& opt) {
    std::ostringstream out;
    out << flavorHeader(opt.flavor);
    out << "(Laser mode.)\n\n";
    out << "(Feedrate: " << number(opt.feedXY, opt.feedDecimals) << " mm/min)\n";
    out << "(Feedrate rapids: 1500 mm/min)\n\n";
    out << "(Z Focus: " << number(opt.zFocus, opt.decimals) << " mm)\n";
    out << "(Steps per circle: 64)\n";
    out << "(Preprocessor Geometry: GRBL_laser)\n\n";
    if (job.bounds.valid) {
        out << "(X range: " << number(job.bounds.xmin, opt.decimals) << " ... "
            << number(job.bounds.xmax, opt.decimals) << " mm)\n";
        out << "(Y range: " << number(job.bounds.ymin, opt.decimals) << " ... "
            << number(job.bounds.ymax, opt.decimals) << " mm)\n\n";
    }
    out << "(Laser Power - Spindle Speed: " << number(opt.laserPower, 1) << ")\n\n";
    out << "G00 Z" << number(opt.zFocus, opt.decimals) << "\n\n";
    out << "G21\nG90\nG17\nG94\n\n";
    out << "G01 F" << number(opt.feedXY, opt.feedDecimals) << "\n\n";
    out << laserOffCommand(opt.flavor) << "\n";

    for (const std::vector<Pt>& path : job.paths) {
        if (path.size() < 2) continue;
        out << laserOffCommand(opt.flavor) << "\n";
        out << "G00 " << xy(path.front(), opt) << "\n";
        out << laserOnCommand(opt.flavor, opt.laserPower) << "\n";
        for (std::size_t i = 1; i < path.size(); ++i) {
            out << "G01 " << xy(path[i], opt) << " F" << number(opt.feedXY, opt.feedDecimals) << "\n";
        }
    }
    out << laserOffCommand(opt.flavor) << "\n";
    return out.str();
}

}  // namespace

/**
 * @brief Genera el programa de dosificación de pasta de soldar.
 *
 * Cabecera con boquilla por defecto y límites, unidades y modo absoluto; luego,
 * por cada punto (en orden directo o invertido si `job.reverse`), si hay tabla
 * de boquillas completa compara el índice con el anterior y, al cambiar, emite
 * un comentario con el diámetro y —si `includeToolChange`— una pausa `M0` para
 * el cambio manual. Cada punto se ejecuta como: rápido XY, rápido a `zMove`,
 * bajada a `zCut` con `feedZ`, pausa `G04` según boquilla y retracción a
 * `zEnd`. Cierra con `G00 Z zMove`, `M05` y `M02`.
 *
 * @param job Puntos, tabla de boquillas, pausas y límites.
 * @param opt Parámetros de máquina y formato.
 * @return Programa G-code de dosificación.
 *
 * @note Si `nozzles` o `nozzleDwells` no tienen exactamente el mismo tamaño que
 *       `points` se ignoran y se usa la boquilla/pausa por defecto, de modo que
 *       un script incompleto no desalinea los datos.
 * @note El orden invertido se aplica indexando desde el final en lugar de
 *       invertir el vector, así las tablas paralelas siguen alineadas.
 * @warning `M05` y `M02` se emiten siempre, incluso si el equipo no tiene
 *          husillo; algunos firmwares aceptan ambos comandos sin efecto.
 * @warning `zCut` se usa como altura de dosificación: si viene con el valor por
 *          defecto de corte (negativo) la boquilla penetrará en la placa.
 */
std::string pasteGCode(const PasteJob& job, const GCodeOptions& opt) {
    std::ostringstream out;
    out << "(Solder paste dispensing program generated by FlatCAM C++.)\n";
    out << "(Nozzle diameter: " << number(job.nozzleDiameter, opt.decimals) << ")\n";
    if (job.bounds.valid) {
        out << "(X range: " << number(job.bounds.xmin, opt.decimals) << " ... "
            << number(job.bounds.xmax, opt.decimals) << ")\n";
        out << "(Y range: " << number(job.bounds.ymin, opt.decimals) << " ... "
            << number(job.bounds.ymax, opt.decimals) << ")\n";
    }
    out << (opt.units == Units::Inch ? "G20\n" : "G21\n");
    out << "G90\nG94\n";
    out << "G00 Z" << number(opt.zStart, opt.decimals) << "\n";
    int currentNozzle = -1;
    for (std::size_t step = 0; step < job.points.size(); ++step) {
        const std::size_t index = job.reverse ? job.points.size() - 1 - step : step;
        const Pt& p = job.points[index];
        if (job.nozzles.size() == job.points.size() &&
            job.nozzles[index] != currentNozzle) {
            currentNozzle = job.nozzles[index];
            const double dia = currentNozzle >= 0 &&
                                       currentNozzle < static_cast<int>(job.nozzleDiameters.size())
                                   ? job.nozzleDiameters[static_cast<std::size_t>(currentNozzle)]
                                   : job.nozzleDiameter;
            out << "(Nozzle T" << (currentNozzle + 1) << " - dia "
                << number(dia, opt.decimals) << " mm)\n";
            if (opt.includeToolChange) out << "M0\n";
        }
        out << "G00 " << xy(p, opt) << "\n";
        out << "G00 Z" << number(opt.zMove, opt.decimals) << "\n";
        out << "G01 Z" << number(opt.zCut, opt.decimals) << " F"
            << number(opt.feedZ, opt.feedDecimals) << "\n";
        const double dwell = job.nozzleDwells.size() == job.points.size()
                                 ? job.nozzleDwells[index]
                                 : opt.dwellTime;
        if (dwell > 0.0) out << "G04 P" << number(dwell, opt.feedDecimals) << "\n";
        out << "G01 Z" << number(opt.zEnd, opt.decimals) << " F"
            << number(opt.feedZ, opt.feedDecimals) << "\n";
    }
    out << "G00 Z" << number(opt.zMove, opt.decimals) << "\n";
    if (opt.endXY) out << "G00 " << xy(*opt.endXY, opt) << "\n";
    out << "M05\nM02\n";
    return out.str();
}

/**
 * @brief Genera el G-code de una herramienta que sigue una lista de recorridos.
 *
 * Despacha según el postprocesador:
 * - láser → `laserPathsGCode`;
 * - `Hpgl` → `IN; SP1; PU/PD; PA...` con coordenadas en mm;
 * - `LineXyz` → `G00/G01` con `X`, `Y` y `Z` explícitos en cada movimiento;
 * - resto → programa G-code convencional.
 *
 * En el camino convencional se escribe cabecera con diámetro, avances, Z y
 * límites, unidades, `G90/G94`, husillo y cambio de herramienta opcional.
 * Luego se calculan las profundidades parciales: si `depthPerPass > 0` y
 * `zCut != 0` se generan escalones desde 0 hasta `zCut`; si no, una sola
 * profundidad. Cada recorrido se ejecuta completo a cada profundidad, salvo que
 * `connectPaths` permita enlazarlo con el anterior sin retraer (si el inicio
 * está a menos de `connectTolerance` del final previo).
 *
 * @param job Recorridos, límites y diámetro informativo.
 * @param opt Parámetros de máquina, unidades y postprocesador.
 * @return Programa G-code.
 *
 * @note Los recorridos con menos de 2 puntos se omiten.
 * @note `connectPaths` sólo evita la retracción y el reposicionamiento; no
 *       agrega ningún movimiento de enlace, por lo que el tramo entre el final
 *       anterior y el inicio actual se mecaniza en línea recta.
 * @warning Con `depthPerPass > 0` cada nivel repite el recorrido completo,
 *          incluso los ya cortados, lo que alarga el programa pero mantiene la
 *          carga de fresado constante (mismo criterio que FlatCAM).
 * @warning En modo `LineXyz` no se emiten cambios de herramienta ni husillo,
 *          y se usa `zCut` para todos los movimientos lineales, sin multipasada.
 */
std::string pathsGCode(const PathJob& job, const GCodeOptions& opt) {
    if (isLaserFlavor(opt.flavor)) return laserPathsGCode(job, opt);
    if (opt.flavor == GCodeFlavor::Hpgl) {
        std::ostringstream hpgl;
        hpgl << "IN;\nSP1;\nPU;\n";
        for (const std::vector<Pt>& path : job.paths) {
            if (path.size() < 2) continue;
            hpgl << "PU;PA" << number(path.front().x, opt.decimals) << ","
                 << number(path.front().y, opt.decimals) << ";\nPD;\n";
            for (std::size_t i = 1; i < path.size(); ++i)
                hpgl << "PA" << number(path[i].x, opt.decimals) << ","
                     << number(path[i].y, opt.decimals) << ";\n";
        }
        hpgl << "PU;\nSP0;\n";
        return hpgl.str();
    }
    if (opt.flavor == GCodeFlavor::LineXyz) {
        std::ostringstream xyz;
        xyz << flavorHeader(opt.flavor);
        xyz << (opt.units == Units::Inch ? "G20\n" : "G21\n") << "G90\n";
        for (const std::vector<Pt>& path : job.paths) {
            if (path.size() < 2) continue;
            xyz << "G00 X" << number(path.front().x, opt.decimals)
                << " Y" << number(path.front().y, opt.decimals)
                << " Z" << number(opt.zMove, opt.decimals) << "\n";
            for (std::size_t i = 1; i < path.size(); ++i)
                xyz << "G01 X" << number(path[i].x, opt.decimals)
                    << " Y" << number(path[i].y, opt.decimals)
                    << " Z" << number(opt.zCut, opt.decimals)
                    << " F" << number(opt.feedXY, opt.feedDecimals) << "\n";
        }
        return xyz.str();
    }

    std::ostringstream out;
    out << flavorHeader(opt.flavor);
    out << "(Generated by FlatCAM C++.)\n\n";

    out << "(TOOL DIAMETER: " << number(job.toolDiameter, opt.decimals) << " "
        << (opt.units == Units::Inch ? "in" : "mm") << ")\n";
    out << "(Feedrate_XY: " << number(opt.feedXY, opt.feedDecimals) << ")\n";
    out << "(Feedrate_Z: " << number(opt.feedZ, opt.feedDecimals) << ")\n";
    out << "(Z_Cut: " << number(opt.zCut, opt.decimals) << ")\n";
    out << "(Z_Move: " << number(opt.zMove, opt.decimals) << ")\n";
    if (job.bounds.valid) {
        out << "(X range: " << number(job.bounds.xmin, opt.decimals) << " ... "
            << number(job.bounds.xmax, opt.decimals) << ")\n";
        out << "(Y range: " << number(job.bounds.ymin, opt.decimals) << " ... "
            << number(job.bounds.ymax, opt.decimals) << ")\n";
    }
    out << "\n(Spindle Speed: " << number(opt.spindleSpeed, 0) << " RPM)\n";
    out << (opt.units == Units::Inch ? "G20\n" : "G21\n");
    out << "G90\n";
    out << "G94\n";
    if (opt.spindleSpeed > 0.0) {
        out << (opt.spindleCw ? "M03" : "M04") << " S" << number(opt.spindleSpeed, 0) << "\n";
    }
    out << "G00 Z" << number(opt.zStart, opt.decimals) << "\n";

    if (opt.includeToolChange && opt.flavor == GCodeFlavor::ToolchangeCustom &&
        !opt.customToolchange.empty()) {
        out << customToolchangeCode(opt, 1, job.toolDiameter) << "\n";
        out << "G00 Z" << number(opt.zMove, opt.decimals) << "\n";
    } else if (opt.includeToolChange) {
        out << "M5\n";
        out << "G00 Z" << number(opt.zToolchange, opt.decimals) << "\n";
        if (opt.toolchangeXY) out << "G00 " << xy(*opt.toolchangeXY, opt) << "\n";
        out << "T1\n";
        if (usesM6(opt.flavor)) {
            out << "M6\n";
            out << "(MSG, Change to Tool Dia = " << number(job.toolDiameter, opt.decimals) << ")\n";
            out << "M0\n";
        }
        out << "G00 Z" << number(opt.zToolchange, opt.decimals) << "\n";
        out << "G00 Z" << number(opt.zMove, opt.decimals) << "\n";
    }

    std::vector<double> depths;
    if (opt.depthPerPass > 0.0 && opt.zCut != 0.0) {
        const double total = std::fabs(opt.zCut);
        const int steps = std::max(1, static_cast<int>(std::ceil(total / opt.depthPerPass)));
        for (int i = 1; i <= steps; ++i) {
            depths.push_back(-std::min(total, i * opt.depthPerPass));
        }
    } else {
        depths.push_back(opt.zCut);
    }

    bool atDepth = false;
    Pt lastPoint;
    for (const std::vector<Pt>& path : job.paths) {
        if (path.size() < 2) continue;
        const bool link = opt.connectPaths && atDepth &&
                          std::hypot(path.front().x - lastPoint.x,
                                     path.front().y - lastPoint.y) <= opt.connectTolerance;
        if (!link) {
            if (atDepth) out << "G00 Z" << number(opt.zMove, opt.decimals) << "\n";
            out << "G00 " << xy(path.front(), opt) << "\n";
            for (double depth : depths) {
                out << "G01 Z" << number(depth, opt.decimals) << " F"
                    << number(opt.feedZ, opt.feedDecimals) << "\n";
                for (std::size_t i = 1; i < path.size(); ++i) {
                    out << "G01 " << xy(path[i], opt) << " F"
                        << number(opt.feedXY, opt.feedDecimals) << "\n";
                }
            }
        } else {
            out << "G01 " << xy(path.front(), opt) << " F"
                << number(opt.feedXY, opt.feedDecimals) << "\n";
            for (std::size_t i = 1; i < path.size(); ++i) {
                out << "G01 " << xy(path[i], opt) << " F"
                    << number(opt.feedXY, opt.feedDecimals) << "\n";
            }
        }
        atDepth = true;
        lastPoint = path.back();
    }
    if (atDepth) out << "G00 Z" << number(opt.zMove, opt.decimals) << "\n";

    if (opt.spindleSpeed > 0.0) out << "M05\n";
    out << "G00 Z" << number(opt.zEnd, opt.decimals) << "\n";
    if (opt.endXY) out << "G00 " << xy(*opt.endXY, opt) << "\n";
    return out.str();
}

/**
 * @brief Genera un programa de geometría con varias herramientas.
 *
 * Escribe una cabecera común (lista de herramientas y diámetros, unidades,
 * `G90/G94`, `zStart`) —o la cabecera láser si el postprocesador es láser— y
 * luego, por cada herramienta, el cambio correspondiente (`ToolchangeCustom`
 * expandido, o `M5` + `zToolchange` + `Tn` + `M6`/comentario), el husillo si
 * tiene RPM propias y todos sus recorridos con multipasada. Cierra con `M05`,
 * `zEnd` y `endXY`.
 *
 * @param tools Herramientas en orden de ejecución, cada una con sus propias
 *              opciones de avance, Z y postprocesador.
 * @param header Opciones comunes: postprocesador, unidades, decimales, `zEnd`,
 *               `endXY` y parámetros láser.
 * @return Programa completo, o cadena vacía si `tools` está vacío.
 *
 * @note En modo láser se respeta la potencia de cada herramienta, pero los
 *       comandos de encendido/apagado se generan con los perfiles de la
 *       herramienta y de la cabecera respectivamente.
 * @note La profundidad por pasada se toma de cada herramienta, no de la
 *       cabecera, igual que los avances y la Z de viaje.
 * @note En modo láser el haz se apaga antes de cada rápido y se enciende al
 *       comenzar cada recorrido, igual que en `laserPathsGCode`.
 */
std::string pathsGCodeMulti(const std::vector<PathToolJob>& tools, const GCodeOptions& header) {
    std::ostringstream out;
    if (tools.empty()) return {};

    const bool laser = isLaserFlavor(header.flavor);
    if (laser) {
        out << "(This preprocessor is used with a motion controller loaded with GRBL firmware.)\n";
        out << "(Laser mode: M03 S<power>, no Z moves.)\n\n";
        out << "(Feedrate: " << number(header.feedXY, header.feedDecimals) << " mm/min)\n";
        out << "(Z Focus: " << number(header.zFocus, header.decimals) << " mm)\n\n";
        out << "G00 Z" << number(header.zFocus, header.decimals) << "\n";
        out << "G21\nG90\nG17\nG94\n";
        out << "G01 F" << number(header.feedXY, header.feedDecimals) << "\n";
    } else {
        out << "(Multi-tool geometry program generated by FlatCAM C++.)\n";
        for (const PathToolJob& tool : tools) {
            out << "(Tool " << tool.number << " -> Dia: " << number(tool.diameter, header.decimals)
                << ")\n";
        }
        out << "\n" << (header.units == Units::Inch ? "G20\n" : "G21\n");
        out << "G90\nG94\n";
        out << "G00 Z" << number(header.zStart, header.decimals) << "\n";
    }

    for (const PathToolJob& tool : tools) {
        const GCodeOptions& opt = tool.options;
        if (laser) {
            for (const auto& path : tool.paths) {
                if (path.size() < 2) continue;
                out << laserOffCommand(header.flavor) << "\n";
                out << "G00 " << xy(path.front(), opt) << "\n";
                out << laserOnCommand(opt.flavor, opt.laserPower) << "\n";
                for (std::size_t i = 1; i < path.size(); ++i)
                    out << "G01 " << xy(path[i], opt) << " F"
                        << number(opt.feedXY, opt.feedDecimals) << "\n";
            }
            out << laserOffCommand(header.flavor) << "\n";
            continue;
        }

        if (header.flavor == GCodeFlavor::ToolchangeCustom && !header.customToolchange.empty()) {
            out << customToolchangeCode(header, tool.number, tool.diameter) << "\n";
            out << "G00 Z" << number(opt.zMove, opt.decimals) << "\n";
        } else {
        out << "M5\n";
        out << "G00 Z" << number(opt.zToolchange, opt.decimals) << "\n";
        out << "T" << tool.number << "\n";
        if (usesM6(header.flavor)) {
            out << "M6\n";
            out << "(MSG, Change to Tool Dia = " << number(tool.diameter, opt.decimals) << ")\n";
            out << "M0\n";
        }
        out << "G00 Z" << number(opt.zToolchange, opt.decimals) << "\n";
        }
        if (opt.spindleSpeed > 0.0) out << "M03 S" << number(opt.spindleSpeed, 0) << "\n";

        std::vector<double> depths;
        if (opt.depthPerPass > 0.0 && opt.zCut != 0.0) {
            const double total = std::fabs(opt.zCut);
            const int steps = std::max(1, static_cast<int>(std::ceil(total / opt.depthPerPass)));
            for (int i = 1; i <= steps; ++i)
                depths.push_back(-std::min(total, i * opt.depthPerPass));
        } else {
            depths.push_back(opt.zCut);
        }

        bool atDepth = false;
        Pt lastPoint;
        for (const auto& path : tool.paths) {
            if (path.size() < 2) continue;
            const bool link = opt.connectPaths && atDepth &&
                              std::hypot(path.front().x - lastPoint.x,
                                         path.front().y - lastPoint.y) <= opt.connectTolerance;
            if (!link) {
                if (atDepth) out << "G00 Z" << number(opt.zMove, opt.decimals) << "\n";
                out << "G00 " << xy(path.front(), opt) << "\n";
                for (double depth : depths) {
                    out << "G01 Z" << number(depth, opt.decimals) << " F"
                        << number(opt.feedZ, opt.feedDecimals) << "\n";
                    for (std::size_t i = 1; i < path.size(); ++i)
                        out << "G01 " << xy(path[i], opt) << " F"
                            << number(opt.feedXY, opt.feedDecimals) << "\n";
                }
            } else {
                out << "G01 " << xy(path.front(), opt) << " F"
                    << number(opt.feedXY, opt.feedDecimals) << "\n";
                for (std::size_t i = 1; i < path.size(); ++i)
                    out << "G01 " << xy(path[i], opt) << " F"
                        << number(opt.feedXY, opt.feedDecimals) << "\n";
            }
            atDepth = true;
            lastPoint = path.back();
        }
        if (atDepth) out << "G00 Z" << number(opt.zMove, opt.decimals) << "\n";
    }

    if (!laser && header.spindleSpeed > 0.0) out << "M05\n";
    out << "G00 Z" << number(header.zEnd, header.decimals) << "\n";
    if (header.endXY) out << "G00 " << xy(*header.endXY, header) << "\n";
    if (laser) out << "M5\n";
    return out.str();
}

/**
 * @brief Construye un `DrillJob` a partir del resultado de un Excellon.
 *
 * Copia los límites y, por cada herramienta del mapa (`std::map`, por lo que
 * quedan ordenadas por número), crea una `DrillTool` con número, diámetro,
 * taladros y ranuras. Las herramientas vacías se descartan.
 *
 * @param result Resultado del parser de Excellon en unidades de la aplicación.
 * @return Trabajo listo para `optimizeDrillOrder` y `drillingGCode`.
 *
 * @note No se transfieren overrides de Z/avance/RPM: el llamador debe
 *       configurarlos si quiere valores por herramienta.
 */
DrillJob drillJobFromExcellon(const ExcellonResult& result) {
    DrillJob job;
    job.bounds = result.bounds;
    job.tools.reserve(result.tools.size());
    for (const auto& [number, tool] : result.tools) {
        if (tool.drills.empty() && tool.slotSegments.empty()) continue;
        DrillTool drill;
        drill.number = number;
        drill.diameter = tool.diameter;
        drill.holes = tool.drills;
        drill.slotSegments = tool.slotSegments;
        job.tools.push_back(std::move(drill));
    }
    return job;
}

}  // namespace fc
